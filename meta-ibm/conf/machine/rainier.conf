## meta-ibm/conf/machine/rainier.conf
```bitbake
KERNEL_DEVICETREE = "aspeed-bmc-ibm-rainier.dtb aspeed-bmc-ibm-rainier-4u.dtb \
                     aspeed-bmc-ibm-rainier-1s4u.dtb aspeed-bmc-ibm-rainier-v2.dtb \
                     aspeed-bmc-ibm-rainier-4u-v2.dtb aspeed-bmc-ibm-everest.dtb"
UBOOT_MACHINE = "ast2600_openbmc_spl_emmc_defconfig"
UBOOT_DEVICETREE = "ast2600-rainier"
SPL_BINARY = "spl/u-boot-spl.bin"

OBMC_POWER_SUPPLY_INSTANCES = "0 1 2 3"

require conf/machine/include/ast2600.inc
require conf/machine/include/obmc-bsp-common.inc
require conf/machine/include/openpower.inc
include conf/machine/include/ibm-power10-cpu.inc
require conf/distro/include/openpower-virtual-pnor.inc
require conf/distro/include/phosphor-mmc.inc
require conf/distro/include/ibm-mpreboot.inc
require conf/machine/include/p10.inc
require conf/distro/include/ibm-mpreboot.inc

OBMC_MACHINE_FEATURES += 'phal'

SERIAL_CONSOLES = "115200;ttyS4"

MRW_XML = "Rainier-2U-MRW.xml"
# TODO: MRW repo has no licence file
#PHOSPHOR_MRW_LICENSE = "Apache-2.0"
#PHOSPHOR_MRW_LIC_FILES_CHKSUM = "file://LICENSE;md5=e3fc50a88d0a364313df4b21ef20c29e"
PHOSPHOR_MRW_URI = "git://git@github.ibm.com/openbmc/rainier-xml.git;protocol=ssh"
PHOSPHOR_MRW_REV = "d7b9fbc4d04fcd3133a9c944b6492169bf5137c9"

VIRTUAL-RUNTIME_phosphor-hwmon-config_df-mrw = ""

PREFERRED_PROVIDER_virtual/phosphor-fan-control-fan-config_df-mrw = \
    "phosphor-fan-control-fan-config"
PREFERRED_PROVIDER_virtual/phosphor-fan-presence-config_df-mrw = \
    "phosphor-fan-presence-config"

SKIP_BROKEN_MRW = "1"

MACHINE_FEATURES += "simicsfs"
IMAGE_FEATURES_remove = "obmc-ikvm"

UBOOT_SIGN_ENABLE = "1"
SPL_SIGN_ENABLE = "1"
SOCSEC_SIGN_ENABLE = "1"
SOCSEC_SIGN_EXTRA_OPTS = "--stack_intersects_verification_region=false"
SOCSEC_SIGN_KEY ?= "${WORKDIR}/rsa_oem_dss_key.pem"

FIT_GENERATE_KEYS = "1"
FIT_HASH_ALG = "sha512"
FIT_SIGN_ALG = "rsa4096"
FIT_SIGN_NUMBITS = "4096"
UBOOT_FITIMAGE_ENABLE = "1"
UBOOT_FIT_GENERATE_KEYS = "1"
UBOOT_FIT_HASH_ALG = "sha512"
UBOOT_FIT_SIGN_ALG = "rsa4096"
UBOOT_FIT_SIGN_NUMBITS = "4096"

UBOOT_SIGN_KEYNAME = "autogenerated-kernel-4096-key"
SPL_SIGN_KEYNAME = "autogenerated-uboot-4096-key"

UBOOT_SIGN_KEYDIR = "${TOPDIR}/signing-keys"
SPL_SIGN_KEYDIR = "${TOPDIR}/signing-keys"
```

## meta-openpower/conf/machine/include/p10.inc
```bitbake
OBMC_MACHINE_FEATURES += 'op-fsi'
PREFERRED_PROVIDER_virtual/obmc-host-ctl = "p9-host-start"
TARGET_PROC = 'p10'
```
